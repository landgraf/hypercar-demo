## conf/distro/hypercar.conf
```bitbake
DISTRO_VERSION = "0.0.1"
DISTRO_CODENAME = "0.0.1"
DISTRO = "hypercar"
DISTRO_NAME = "Suse automotive Hypercar Demo"

SDK_VENDOR = "-suse"
SDK_VERSION = "${@d.getVar('DISTRO_VERSION').replace('snapshot-${DATE}', 'snapshot')}"

MAINTAINER = "Pavel Zhukov <pazhukov@suse.de>"

TARGET_VENDOR = "-suse"

LOCALCONF_VERSION = "2"

DISTRO_FEATURES = "${DISTRO_FEATURES_DEFAULT} systemd virtualization "
DISTRO_FEATURES_DEFAULT:remove = " nfs nfc 3g pcmcia x11 debuginfod package-management"
DISTRO_EXTRA_RDEPENDS = " packagegroup-core-boot "
IMAGE_INSTALL:append  = " xen-tools"

require conf/distro/include/no-static-libs.inc
require conf/distro/include/yocto-uninative.inc
INHERIT += "uninative"

BB_SIGNATURE_HANDLER ?= "OEEquivHash"
BB_HASHSERVE ??= "auto"

TCLIBC ?= "musl"
COMPATIBLE_MACHINES = "qemuarm64-xen"

# Set default hostname to reflect the DISTRO
hostname:pn-base-files = "${DISTRO}-${MACHINE}"
INIT_MANAGER = "systemd"
BB_DANGLINGAPPENDS_WARNONLY:forcevariable = "0"
EFI_PREFIX = "/boot/efi"
EFI_BOOT_IMAGE = "xen-qemuarm64-xen.efi"
IMAGE_EFI_BOOT_FILES += "${KERNEL_IMAGETYPE};EFI/BOOT/ xen-qemuarm64-xen.efi;EFI/BOOT/  qemu-aarch64-gicv3.dtb;EFI/BOOT/ xen.cfg;EFI/BOOT/"
```

## conf/machine/qemuarm64-xen-uboot.conf
```bitbake
require conf/machine/include/arm/armv8a/tune-cortexa57.inc
require conf/machine/include/qemu.inc

KERNEL_IMAGETYPE = "Image"

# Use the qemuarm64 kernel config as the base config of this machine 
# TODO Add Xen ? 
KMACHINE = "qemuarm64"

# For runqemu
MACHINE_EXTRA_RDEPENDS:append = "u-boot"

IMAGE_FSTYPES += " wic "
WKS_FILE ?= "hypercar-uboot.wks"
UBOOT_MACHINE = "qemu_arm64_defconfig"

QB_SYSTEM_NAME = "qemu-system-aarch64"
QB_MACHINE_VIRT_HIGHMEM = "on"
QB_CPU = "-cpu cortex-a57"
QB_MACHINE = " -machine virtualization=true   -machine virt,gic_version=3"
QB_DEFAULT_BIOS = "u-boot-qemuarm64-xen-uboot.bin"
QB_ROOTFS_OPT = "-drive id=hd0,file=@ROOTFS@,if=none,format=raw -device -device ich9-ahci,id=ahci -device ide-drive,drive=hd0,bus=ahci.0"
IMAGE_BOOT_FILES="${KERNEL_IMAGETYPE} xen-qemuarm64-xen-uboot"


PREFERRED_PROVIDER_virtual/kernel ?= "linux-yocto"
KBUILD_DEFCONFIG = "defconfig"
MACHINE_EXTRA_RRECOMMENDS += "kernel-modules qemu-dtb"
```

## conf/machine/qemuarm64-xen.conf
```bitbake
require conf/machine/include/arm/armv8a/tune-cortexa57.inc
require conf/machine/include/qemu-efi.inc

KERNEL_IMAGETYPE ?= "Image"

# Use the qemuarm64 kernel config as the base config of this machine 
# TODO Add Xen ? 
KMACHINE = "qemuarm64"

# For runqemu
QB_SYSTEM_NAME = "qemu-system-aarch64"
QB_MACHINE_VIRT_HIGHMEM = "on"
QB_CPU = "-cpu cortex-a57"
MACHINE_EXTRA_RDEPENDS:append = "qemu-dtb"
```

## meta-hypercar/conf/distro/hypercar.conf
```bitbake
DISTRO_VERSION = "0.0.1"
DISTRO_CODENAME = "0.0.1"
DISTRO = "hypercar"
DISTRO_NAME = "Suse automotive Hypercar Demo"

SDK_VENDOR = "-suse"
SDK_VERSION = "${@d.getVar('DISTRO_VERSION').replace('snapshot-${DATE}', 'snapshot')}"

MAINTAINER = "Pavel Zhukov <pazhukov@suse.de>"

TARGET_VENDOR = "-suse"

LOCALCONF_VERSION = "2"

DISTRO_FEATURES = "${DISTRO_FEATURES_DEFAULT} systemd virtualization xen usrmerge"
DISTRO_FEATURES_DEFAULT:remove = " nfs nfc 3g pcmcia x11 debuginfod package-management"
##DISTRO_EXTRA_RDEPENDS = " packagegroup-core-boot "
IMAGE_INSTALL:append  = " xen-tools xen-dom0less-config linux-app"

require conf/distro/include/no-static-libs.inc
require conf/distro/include/yocto-uninative.inc
INHERIT += "uninative"
BB_SIGNATURE_HANDLER ?= "OEEquivHash"
BB_HASHSERVE ??= "auto"
HYPERCAR_DOMS = "virtual/kernel zephyr-helloworld zephyr-synchronization alp-automotive-rt-kernel"
IMAGE_INSTALL:append = " networkmanager alp-automotive-kernel zephyr-helloworld zephyr-synchronization alp-automotive-rt-kernel" 
## freertos-xen"

## FIXME xen doesn't build with musl
TCLIBC ?= "glibc"
COMPATIBLE_MACHINES = "qemuarm64-xen-efi qemuarm64-xen-uboot raspberrypi4-64"

# Set default hostname to reflect the DISTRO
hostname:pn-base-files = "${DISTRO}-${MACHINE}"
INIT_MANAGER = "systemd"
BB_DANGLINGAPPENDS_WARNONLY:forcevariable = "0"
PREFERRED_PROVIDER_virtual/kernel ?= "linux-raspberrypi"
PREFERRED_VERSION_linux-yocto = "6.1.25+gitAUTOINC+36901b5b29_581dc1aa2f"
PREFERRED_VERSION_xen = "4.18+gitAUTOINC+608f85a181"

MMCBLKDEVICE_NUMBER = "${@ '0' if d.getVar('PREFERRED_PROVIDER_virtual/kernel') == 'linux-raspberrypi' else '1'  }"
MMCBLKDEVICE = "mmcblk${MMCBLKDEVICE_NUMBER}"

PREFERRED_PROVIDER_u-boot-default-script = "uboot-xen-config"
IMAGE_BOOT_FILES:append=" u-boot.bin  ${KERNEL_IMAGETYPE} xen boot.scr boot.source Image-alp zephyr-helloworld.bin  zephyr-synchronization.bin Image-alprt"
WKS_FILE:raspberrypi4-64="hypercar_rpi.wks.in"

ZEPHYR_BOARD = "xenvm_gicv3"
## rpi has GICv2
ZEPHYR_BOARD:raspberrypi4-64 = "xenvm"
```

## meta-hypercar/conf/layer.conf
```bitbake
# We have a conf and classes directory, add to BBPATH
BBPATH .= ":${LAYERDIR}"

# We have recipes-* directories, add to BBFILES
BBFILES += "${LAYERDIR}/recipes-*/*/*.bb \
            ${LAYERDIR}/recipes-*/*/*.bbappend"

BBFILE_COLLECTIONS += "meta-hypercar"
BBFILE_PATTERN_meta-hypercar = "^${LAYERDIR}/"
BBFILE_PRIORITY_meta-hypercar = "6"

LAYERDEPENDS_meta-hypercar = "core \
			      virtualization-layer \
			      filesystems-layer \
			      zephyrbsp \
			      networking-layer \
			      openembedded-layer"
LAYERSERIES_COMPAT_meta-hypercar = "mickledore"
```

## meta-hypercar/conf/machine/qemuarm64-xen-efi.conf
```bitbake
require conf/machine/include/arm/armv8a/tune-cortexa57.inc
require conf/machine/include/qemu-efi.inc

KERNEL_IMAGETYPE = "Image"

# Use the qemuarm64 kernel config as the base config of this machine 
# TODO Add Xen ? 
KMACHINE = "qemuarm64"

# For runqemu
QB_SYSTEM_NAME = "qemu-system-aarch64"
QB_MACHINE_VIRT_HIGHMEM = "on"
QB_CPU = "-cpu cortex-a57"
MACHINE_EXTRA_RDEPENDS:append = "qemu-dtb"
EFI_PROVIDER = "xen"
EFI_PREFIX = "/boot/efi"
EFI_BOOT_IMAGE = "xen-qemuarm64-xen.efi"
IMAGE_EFI_BOOT_FILES += "${KERNEL_IMAGETYPE};EFI/BOOT/ xen-qemuarm64-xen-efi.efi;EFI/BOOT/xen.efi  qemu-aarch64-gicv3.dtb;EFI/BOOT/ xen.cfg;EFI/BOOT/"
IMAGE_FSTYPES += " wic "
WKS_FILE ?= "hypercar-efi.wks"
```

## meta-hypercar/conf/machine/qemuarm64-xen-uboot.conf
```bitbake
require conf/machine/include/arm/armv8a/tune-cortexa57.inc
require conf/machine/include/qemu.inc

KERNEL_IMAGETYPE = "Image"

# Use the qemuarm64 kernel config as the base config of this machine 
# TODO Add Xen ? 
KMACHINE = "qemuarm64"

# For runqemu
MACHINE_EXTRA_RDEPENDS:append = "u-boot"
DEPENDS = "uboot-xen-config-native"

IMAGE_FSTYPES += " wic "
WKS_FILE ?= "hypercar-uboot.wks"
UBOOT_MACHINE = "qemu_arm64_defconfig"
UBOOT_DTB = "qemu-arm64.dts"
UBOOT_DTB_BINARY = "qemu-arm64.dtb"
QB_SYSTEM_NAME = "qemu-system-aarch64"
QB_MACHINE_VIRT_HIGHMEM = "on"
QB_CPU = "-cpu cortex-a57"
QB_MACHINE = " -machine virtualization=true -machine virt,gic_version=3"
QB_DEFAULT_BIOS = "u-boot-qemuarm64-xen-uboot.bin"
QB_MEM = "-m 4096"
QB_SMP = "-smp 4"

PREFERRED_PROVIDER_virtual/kernel ?= "linux-yocto"
### KBUILD_DEFCONFIG = "defconfig"
KCONFIG_MODE = "allnoconfig"
MACHINE_EXTRA_RRECOMMENDS += "kernel-modules "
IMAGE_BOOT_FILES="u-boot.bin  qemu-arm64_generated.dtb ${KERNEL_IMAGETYPE} xen boot.scr boot.source  ${KERNEL_IMAGETYPE}_DomU  ${KERNEL_IMAGETYPE}_Dom0 zephyr-synchronization.bin zephyr.conf"

QB_DRIVE_TYPE="/dev/vdb"
MACHINE_DTB_PROVIDER="qemu-dtb-native"
```

## meta-hypercar/wic/hypercar-uboot.wks
```
part none --source bootimg-partition --ondisk=vda --fstype=vfat --label boot --active --align 4096 --fixed-size 512
part /     --source rootfs --ondisk=vda --fstype=ext4 --label dom0root  --align 4096 --fixed-size 2048 --exclude-path data/ --exclude-path boot/
part none --source rootfs --ondisk=xvda --fstype=ext4 --label dom0root  --align 4096 --fixed-size 2048 --exclude-path data/ --exclude-path boot/
part none --source rootfs --ondisk=xvda --fstype=ext4 --label dom0root  --align 4096 --fixed-size 2048 --exclude-path data/ --exclude-path boot/
```

## wic/hypercar-uboot.wks
```
part /boot --source bootimg-partition --ondisk=sda --fstype=vfat --label boot --active --align 4096 --fixed-size 512 --use-uuid 
part /     --source rootfs --ondisk=sda --fstype=ext4 --label dom0root  --align 4096 --fixed-size 2048 --exclude-path data/ --exclude-path boot/
part empty --ondisk mmcblk0 --fstype=none  --align 4096 --fixed-size 512 
```

## wic/hypercar.wks
```
bootloader  --ptable gpt --timeout=0  --append="rootwait"
part /boot --source bootimg-efi --sourceparams="loader=uefi-kernel,dtb=qemu-aarch64-gicv3.dtb" --ondisk=sda --fstype=vfat --label boot --active --align 1024 --use-uuid 
part /     --source rootfs --ondisk mmcblk0 --fstype=ext4 --label dom0root  --align 4096 --fixed-size 2048 --exclude-path data/ --exclude-path boot/
part empty --ondisk mmcblk0 --fstype=none  --align 4096 --fixed-size 512 
```
